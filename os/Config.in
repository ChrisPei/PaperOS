## os/Config.in
```kconfig
source "$BR2_EXTERNAL_PAPEROS_PATH/package/paperos/Config.in"
source "$BR2_EXTERNAL_PAPEROS_PATH/package/paperos-drivers/Config.in"
```

## os/configs/kt3_defconfig
```kconfig
BR2_arm=y
BR2_cortex_a9=y
BR2_ARM_EABI=y
BR2_ARM_SOFT_FLOAT=y
BR2_TOOLCHAIN_BUILDROOT_MUSL=y
BR2_SHARED_STATIC_LIBS=y
BR2_TARGET_GENERIC_HOSTNAME="paperos-kt3"
BR2_TARGET_GENERIC_ISSUE="PaperOS for Kindle KT3"
BR2_INIT_BUSYBOX=y
BR2_ROOTFS_DEVICE_CREATION_DYNAMIC_MDEV=y
BR2_ROOTFS_DEVICE_TABLE="system/device_table.txt $(BR2_EXTERNAL_PAPEROS_PATH)/board/kt3/device_table.txt"
BR2_TARGET_GENERIC_GETTY_PORT="ttymxc0"
BR2_TARGET_GENERIC_GETTY_BAUDRATE_115200=y
BR2_ROOTFS_OVERLAY="$(BR2_EXTERNAL_PAPEROS_PATH)/rootfs-overlay"
BR2_PACKAGE_PAPEROS=y
BR2_PACKAGE_PAPEROS_DRIVERS=y
BR2_PACKAGE_HOST_KMOD=y
BR2_PACKAGE_WPA_SUPPLICANT=y
BR2_PACKAGE_WPA_SUPPLICANT_CLI=y
BR2_PACKAGE_WPA_SUPPLICANT_PASSPHRASE=y
BR2_PACKAGE_CA_CERTIFICATES=y
BR2_PACKAGE_DROPBEAR=y
BR2_PACKAGE_DROPBEAR_DISABLE_REVERSEDNS=y
BR2_PACKAGE_DROPBEAR_SMALL=y
BR2_PACKAGE_DROPBEAR_LOCALOPTIONS_FILE="$(BR2_EXTERNAL_PAPEROS_PATH)/board/kt3/dropbear-options.h"
BR2_TARGET_ROOTFS_TAR=y
BR2_TARGET_ROOTFS_EXT2=y
BR2_TARGET_ROOTFS_EXT2_3=y
BR2_TARGET_ROOTFS_EXT2_SIZE="256M"
BR2_TARGET_ROOTFS_EXT2_LABEL="paperos-root"
BR2_TARGET_ROOTFS_EXT2_MKFS_OPTIONS="-O ^64bit,^metadata_csum,^orphan_file"
# No kernel or bootloader is replaced by this build target.
```

## os/package/paperos-drivers/Config.in
```kconfig
config BR2_PACKAGE_PAPEROS_DRIVERS
	bool "KT3 matching reference display and touch drivers"
	depends on BR2_arm
	help
	  Uses matching modules extracted from the public 5.16.2.1.1 reference
	  firmware by scripts/import-kt3-drivers.py. Requires the matching
	  3.10.53-lab126 kernel. Includes the proprietary EPDC companion;
	  the resulting local image is not a source-only distribution.
```

## os/package/paperos/Config.in
```kconfig
config BR2_PACKAGE_PAPEROS
	bool "PaperOS native shell"
	help
	  Native grayscale framebuffer apps, evdev touch input and agent dashboard.
```
